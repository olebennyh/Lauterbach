;-----------------------------------------------------------------------------------
; @Title: Simple sieve demo running from FLASH for STM32F4xx derivatives
; @Description:
;   This is a small demo running from FLASH showing how to setup a debug 
;   session  on Cortex-M4 for STM32F4DISCOVERY board. The sieve demo is   
;   loaded on flash using the board support scripts of the TRACE32 
;   installation.
;   Prerequisites : see ../stm32f4/readme.txt
; @Keywords: Cortex-M4, debug, STM32, SWD
; @Author: HDA
; @Board: STM32F4DISCOVERY
; @Chip: STM32F4*
; @Copyright: (C) 1989-2022 Lauterbach GmbH, licensed for use with TRACE32(R) only
; --------------------------------------------------------------------------------
; $Id: stm32f4_discovery_sieve_flash.cmm 18877 2022-02-02 07:04:07Z bschroefel $

; Basic setup
  RESet
  SYStem.RESet
  SYStem.CPU STM32F417IG
  SYStem.CONFIG.DEBUGPORTTYPE SWD
  SYStem.MemAccess DAP
  SYStem.Option DUALPORT ON
  SYStem.Up


  ; Setup flash configuration using the board support scripts of the TRACE32 installation
  DO ~~/demo/arm/flash/stm32f4xx.cmm PREPAREONLY DUALPORT=1

  ; Program the internal flash
  ;FLASH.ReProgram.ALL /Erase
  ; D:\Development\Project\R-BMC_R-SMC\R-BMC_417_BootLoader\Debug
  ;Data.LOAD.Elf R-BMC_417_Bootloader\Debug\R-BMC_417_BootLoader.elf /plusvm
  ; D:\Development\Project\R-BMC_R-SMC\R-BMC_417_V1\Debug
  ;Data.LOAD.Elf R-BMC_417_V1\Debug\R-BMC_417_V1.elf /noclear /plusvm
  FLASH.ReProgram.off
  mode.hll
  ; Reset device
  SYStem.Down
  SYStem.Up
  ; r.set PC \\R_BMC_417_BootLoader\Global\Reset_Handler 
  ; Loading symbol information
  ; Data.LOAD.Elf ~~~~/demo_flash.axf /NoCODE

  ;Go.direct \\R_BMC_417_V1\main\main\3
  ; Go.direct \\R-BMC_417_Bootloader\main\main
  ; Go.direct \\R-BMC_417_Bootloader\main\main\1
  Wait !run()
  ; open some windows
  WinCLEAR

  WinPOS 0% 0% 50% 50%
  List.auto

  WinPOS 50% 0% 50% 50%
  Register.view /SpotLight

  WinPOS 0% 50% 50% 30%
  Frame /Locals /Caller

 ;tpiu.portsize SWV
 ;tpiu.SWVPrescaler 8
 ;  ITM.on
 ITM.off
trace.off
;ITM.PCSampler 1/128
;T.AF
 task.config ~~/demo/arm/kernel/threadx/threadx.t32
 
  ENDDO