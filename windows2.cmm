// T32_1000001 Thu May 11 12:48:18 2023

B::

TOOLBAR   ON
STATUSBAR ON
FramePOS 39.111,23.467,,,Maximized
WinPAGE.RESet

WinPAGE.Create P000
WinCLEAR

WinPOS 0.0 0.0 209. 59. 16. 1. W000
WinTABS 10. 10. 25.
List.auto

WinPOS 313.89 65.733 100. 25. 0. 0. W004
AREA

WinPOS 307.67 97.2 114. 26. 26. 1. W005
WinTABS 41. 31.
sYmbol.List.TREE

WinPOS 13.333 97.333 63. 26. 0. 1. W006
WinTABS 10. 13. 5. 9.
TASK.THread

WinPOS 0.0 63.0 209. 27. 5. 0. W002
Frame /Locals /Caller

WinPOS 359.67 0.2 64. 22. 0. 0. W001
Trace

WinPOS 280.89 0.6 51. 13. 0. 0. W003
ITM

WinPAGE.select P000

ENDDO
