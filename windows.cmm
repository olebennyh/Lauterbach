// T32_1000001 Thu May 11 10:35:16 2023

B::

TOOLBAR   ON
STATUSBAR ON
FramePOS 39.111,23.467,,,Maximized
WinPAGE.RESet

WinPAGE.Create P000
WinCLEAR

WinPOS 0.0 0.0 209. 59. 16. 1. W000
WinTABS 10. 10. 25.
List.auto

WinPOS 313.89 65.733 100. 25. 0. 0. W004
AREA

WinPOS 307.67 97.2 114. 26. 26. 1. W005
WinTABS 41. 31.
sYmbol.List.TREE

WinPOS 8.3333 97.333 63. 26. 0. 1. W006
WinTABS 10. 13. 5. 9.
TASK.THread

WinPOS 0.0 63.0 209. 27. 5. 0. W002
Frame /Locals /Caller

WinPOS 67.667 96.533 146. 25. 25. 3. W007
WinTABS 16. 52.
Trace.STATistic.FUNC

WinPOS 213.33 65.733 92. 24. 12. 1. W003
WinTABS 32.
Trace.List

WinPOS 214.0 0.0 209. 35. 0. 0. W001
Register.view /SpotLight

WinPOS 222.89 40.267 64. 14. 0. 0. W010
ETM

WinPOS 241.22 89.467 64. 22. 0. 0. W008
Trace

WinPOS 372.78 40.133 51. 15. 0. 0. W009
ITM.state

WinPOS 310.22 40.2 60. 12. 0. 0. W011
TPIU

WinPAGE.select P000

ENDDO
